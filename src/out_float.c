#include "n1202.h"

/*  Поддерживается только Y_POSITION*2+X_POSITION*3+MUL2+INVERSE без длины и утроенного-учетвереного размера   */
void OutFloat(uint32_t Ctrl, float In, char AddChar)
{
  static const char FloatSuffix[] = {'-','f', 'p', 'n', Mju, 'm', ' ', 'k', 'M', 'G', 'T', '+' }; // символы Множителей
  int16_t e    = 0; // Экспонета 10
  int8_t Step = (Ctrl & MUL2)?2:1; // Величина символа - одинарная или удвоенная
  char c;

  if (In < 0 ) // Отрицательное число
  {
    In = In * -1; // меняем знак
    c = '-'; // Выводим отрицательный знак
  }
  else
    c = ' '; // Число положительно знак не нужен
  LcdChr(Ctrl+1, &c); // Отображаем знак
  Ctrl += X_POSITION*Step; // Сдвигаем текущую позицию по икс

  if ( In != 0 ) // Число не 0
  {
    while ( In >= 10.0f )  /* Пока число больше 10 */
    {
      In = In / 10.0f; // Делим это число на 10
      e++; // Увеличиваем экспоненту
    }

    while ( In < 1.0f )  /* Пока число меньше 1 */
    {
      In = In * 10.0f; // Увеличиваем число в 10 раз
      e--; // и умеьшаем экспоненту
    }
    /* After this 10 < In >= 1  */
  }

  In += 0.0005f; // Округляем до 4 разряда

  {
    int16_t OutLen = 4; // Выводим 4 разряда
    char Flags = 0;
 
    while ( OutLen )  /* Вывод мантисы */
    {
      char Digit = In; // Приведение числа к целому - число от 1 до 10!!!

      c = Digit + '0'; // Символ числа
      LcdChr(Ctrl+1, &c); // Вывод символа
      Ctrl += X_POSITION*Step; // Сдвиг позиции

#define ALREADYDOTED 2
      if ( (Flags & ALREADYDOTED) == 0) // Точка пока не поставлена
      {
        if ( e%3 == 0 ) /* Экспонента кратна 3 */
        {
          Flags |= ALREADYDOTED; // Флаг что уже точка проставлена
          c = '.'; 
          LcdChr((Ctrl&~MUL2)+1+(Step-1)*Y_POSITION, &c); // Вывод точки в нижней позиции
          if ( Step > 1 ) // При удвоенной величине шрифта верхний символ - пробел
          {
            c = ' ';
            LcdChr((Ctrl&~MUL2)+1, &c);
          }
          Ctrl += X_POSITION; // Сдвиг позиции
        }
        else
          e--; // Уменьшение экспоненты так как число увеличилось за счет выведенных символов
      }
    
      In = In - (float)(Digit); // Остаток числа после вычитания челой части

      In = In * 10.0f; // Приведение остатка к диапазону 1 - 10
      OutLen --; // Счетчик выведенных символов уменьшается
    }
  }

  {
    // Вывод суффикса
    if ( e < -18) // Неподдерживаемый суффикс - слишком малое число
      e = -18;
    if (e > 15 ) // неподдерживаемый суффикс - слишком большое число
      e = 12;
    e = e/3; // Экспонента кратна 3
    e += 6; // Сдвиг в массиве относительно начала
    c = FloatSuffix[e]; // Вывод суффикса
    LcdChr(Ctrl+1, &c);
    Ctrl += X_POSITION*Step; // Увеличение позиции
    c = AddChar; // Вывод заключительного символа
    LcdChr(Ctrl+1, &c);
  }
}
